## board/marvell/marvell_v8_sdk_swdev_min_defconfig
```kconfig
CONFIG_CC_OPTIMIZE_FOR_SIZE=y
CONFIG_KERNEL_XZ=y
CONFIG_OPTIMIZE_INLINING=y
CONFIG_SLOB=y
CONFIG_SYSVIPC=y
CONFIG_POSIX_MQUEUE=y
CONFIG_AUDIT=n
CONFIG_NO_HZ_IDLE=y
CONFIG_HIGH_RES_TIMERS=y
CONFIG_PREEMPT=y
CONFIG_IRQ_TIME_ACCOUNTING=n
CONFIG_BSD_PROCESS_ACCT=n
CONFIG_BSD_PROCESS_ACCT_V3=n
CONFIG_TASK_XACCT=n
CONFIG_TASK_IO_ACCOUNTING=n
CONFIG_IKCONFIG=n
CONFIG_IKCONFIG_PROC=n
CONFIG_NUMA_BALANCING=n
CONFIG_MEMCG=n
CONFIG_BLK_CGROUP=n
CONFIG_CGROUP_PIDS=n
CONFIG_CGROUP_HUGETLB=n
CONFIG_CPUSETS=y
CONFIG_CGROUP_DEVICE=n
CONFIG_CGROUP_CPUACCT=n
CONFIG_CGROUP_PERF=n
CONFIG_USER_NS=n
CONFIG_SCHED_AUTOGROUP=n
CONFIG_BLK_DEV_INITRD=y
CONFIG_KALLSYMS_ALL=n
# CONFIG_COMPAT_BRK is not set
CONFIG_PROFILING=n
CONFIG_ARCH_AGILEX=n
CONFIG_ARCH_SUNXI=n
CONFIG_ARCH_ALPINE=n
CONFIG_ARCH_BCM2835=n
CONFIG_ARCH_BCM_IPROC=n
CONFIG_ARCH_BERLIN=n
CONFIG_ARCH_BRCMSTB=n
CONFIG_ARCH_EXYNOS=n
CONFIG_ARCH_K3=n
CONFIG_ARCH_LAYERSCAPE=n
CONFIG_ARCH_LG1K=n
CONFIG_ARCH_HISI=n
CONFIG_ARCH_MEDIATEK=n
CONFIG_ARCH_MESON=n
CONFIG_ARCH_MVEBU=y
CONFIG_ARCH_MXC=n
CONFIG_ARCH_QCOM=n
CONFIG_ARCH_RENESAS=n
CONFIG_ARCH_ROCKCHIP=n
CONFIG_ARCH_SEATTLE=n
CONFIG_ARCH_STRATIX10=n
CONFIG_ARCH_SYNQUACER=n
CONFIG_ARCH_TEGRA=n
CONFIG_ARCH_THUNDER2=n
CONFIG_ARCH_UNIPHIER=n
CONFIG_ARCH_VEXPRESS=n
CONFIG_ARCH_XGENE=n
CONFIG_ARCH_ZX=n
CONFIG_ARCH_ZYNQMP=n
CONFIG_ARM64_VA_BITS_48=y
CONFIG_SCHED_MC=y
CONFIG_NUMA=y
CONFIG_KEXEC=n
CONFIG_CRASH_DUMP=y
CONFIG_XEN=n
CONFIG_COMPAT=n
# CONFIG_ARM64_VHE is not set
CONFIG_RANDOMIZE_BASE=n
CONFIG_WQ_POWER_EFFICIENT_DEFAULT=y
CONFIG_ARM_CPUIDLE=y
CONFIG_ARM_PSCI_CPUIDLE=n
CONFIG_CPU_FREQ=y
CONFIG_CPU_FREQ_STAT=y
CONFIG_CPU_FREQ_GOV_POWERSAVE=y
CONFIG_CPU_FREQ_GOV_USERSPACE=y
CONFIG_CPU_FREQ_GOV_ONDEMAND=y
CONFIG_CPU_FREQ_GOV_CONSERVATIVE=y
CONFIG_CPUFREQ_DT=y
CONFIG_ACPI_CPPC_CPUFREQ=n
CONFIG_ARM_ARMADA_37XX_CPUFREQ=y
CONFIG_ARM_ARMADA_8K_CPUFREQ=y
CONFIG_ARM_SCPI_CPUFREQ=y
CONFIG_ARM_IMX_CPUFREQ_DT=n
CONFIG_ARM_RASPBERRYPI_CPUFREQ=n
CONFIG_ARM_TEGRA186_CPUFREQ=n
CONFIG_ARM_SCPI_PROTOCOL=y
CONFIG_RASPBERRYPI_FIRMWARE=n
CONFIG_INTEL_STRATIX10_SERVICE=n
CONFIG_IMX_SCU=n
CONFIG_IMX_SCU_PD=n
CONFIG_ACPI=n
CONFIG_ACPI_HED=n
CONFIG_VIRTUALIZATION=n
CONFIG_KVM=n
CONFIG_ARM64_CRYPTO=y
CONFIG_CRYPTO_SHA1_ARM64_CE=y
CONFIG_CRYPTO_SHA2_ARM64_CE=y
CONFIG_CRYPTO_SHA512_ARM64_CE=m
CONFIG_CRYPTO_SHA3_ARM64=m
CONFIG_CRYPTO_SM3_ARM64_CE=n
CONFIG_CRYPTO_GHASH_ARM64_CE=n
CONFIG_CRYPTO_CRCT10DIF_ARM64_CE=n
CONFIG_CRYPTO_AES_ARM64_CE_CCM=y
CONFIG_CRYPTO_AES_ARM64_CE_BLK=y
CONFIG_CRYPTO_CHACHA20_NEON=n
CONFIG_CRYPTO_AES_ARM64_BS=m
CONFIG_JUMP_LABEL=y
CONFIG_MODULES=y
CONFIG_MODULE_UNLOAD=y
# CONFIG_CORE_DUMP_DEFAULT_ELF_HEADERS is not set
CONFIG_KSM=n
CONFIG_MEMORY_FAILURE=y
CONFIG_TRANSPARENT_HUGEPAGE=y
CONFIG_NET=y
CONFIG_PACKET=y
CONFIG_UNIX=y
CONFIG_INET=y
CONFIG_IP_MULTICAST=y
CONFIG_IP_ADVANCED_ROUTER=y
CONFIG_IP_ROUTE_MULTIPATH=y
CONFIG_IP_PNP=y
CONFIG_IP_PNP_DHCP=y
CONFIG_IP_PNP_BOOTP=y
CONFIG_IPV6_SIT=m
CONFIG_NETFILTER=y
CONFIG_NF_CONNTRACK=m
CONFIG_NF_CONNTRACK_EVENTS=y
CONFIG_NETFILTER_XT_TARGET_CHECKSUM=m
CONFIG_NETFILTER_XT_TARGET_LOG=m
CONFIG_NETFILTER_XT_MATCH_ADDRTYPE=m
CONFIG_NETFILTER_XT_MATCH_CONNTRACK=m
CONFIG_IP_NF_IPTABLES=m
CONFIG_IP_NF_FILTER=m
CONFIG_IP_NF_TARGET_REJECT=m
CONFIG_IP_NF_NAT=m
CONFIG_IP_NF_TARGET_MASQUERADE=m
CONFIG_IP_NF_MANGLE=m
CONFIG_IP6_NF_IPTABLES=m
CONFIG_IP6_NF_FILTER=m
CONFIG_IP6_NF_TARGET_REJECT=m
CONFIG_IP6_NF_MANGLE=m
CONFIG_IP6_NF_NAT=m
CONFIG_IP6_NF_TARGET_MASQUERADE=m
CONFIG_BRIDGE=m
CONFIG_BRIDGE_VLAN_FILTERING=y
CONFIG_NET_DSA=m
CONFIG_VLAN_8021Q=m
CONFIG_VLAN_8021Q_GVRP=y
CONFIG_VLAN_8021Q_MVRP=y
CONFIG_NET_SCHED=y
CONFIG_NET_SCH_CBQ=y
CONFIG_NET_SCH_HTB=y
CONFIG_NET_SCH_HFSC=y
CONFIG_NET_SCH_PRIO=y
CONFIG_NET_SCH_MULTIQ=y
CONFIG_NET_SCH_SFB=y
CONFIG_NET_SCH_SFQ=y
CONFIG_NET_SCH_TBF=y
CONFIG_NET_SCH_DSMARK=y
CONFIG_NET_SCH_DRR=y
CONFIG_NET_SCH_MQPRIO=y
CONFIG_NET_SCH_FQ=m
CONFIG_NET_SCH_INGRESS=y
CONFIG_NET_CLS_TCINDEX=y
CONFIG_NET_CLS_ROUTE4=y
CONFIG_NET_CLS_FW=y
CONFIG_NET_CLS_U32=y
CONFIG_NET_CLS_FLOW=y
CONFIG_NET_CLS_FLOWER=y
CONFIG_NET_CLS_MATCHALL=y
CONFIG_NET_EMATCH=y
CONFIG_NET_EMATCH_U32=y
CONFIG_NET_EMATCH_META=y
CONFIG_NET_CLS_ACT=y
CONFIG_NET_ACT_POLICE=y
CONFIG_NET_ACT_GACT=y
CONFIG_NET_ACT_MIRRED=y
CONFIG_NET_ACT_NAT=y
CONFIG_NET_ACT_PEDIT=y
CONFIG_NET_ACT_SKBEDIT=y
CONFIG_NET_ACT_VLAN=y
CONFIG_NET_ACT_BPF=y
CONFIG_NET_ACT_SKBMOD=y
CONFIG_NET_TC_SKB_EXT=y
CONFIG_DCB=y
CONFIG_QRTR=n
CONFIG_QRTR_SMD=n
CONFIG_QRTR_TUN=n
CONFIG_BPF_JIT=y
CONFIG_BT=n
CONFIG_BT_HIDP=n
# CONFIG_BT_LE is not set
CONFIG_BT_LEDS=n
# CONFIG_BT_DEBUGFS is not set
CONFIG_BT_HCIBTUSB=n
CONFIG_BT_HCIUART=n
CONFIG_BT_HCIUART_LL=n
CONFIG_BT_HCIUART_BCM=n
CONFIG_CFG80211=m
CONFIG_MAC80211=m
CONFIG_MAC80211_LEDS=y
CONFIG_NET_9P=n
CONFIG_NET_9P_VIRTIO=n
CONFIG_PCI=y
CONFIG_PCIEPORTBUS=y
CONFIG_PCI_IOV=y
CONFIG_HOTPLUG_PCI=y
CONFIG_HOTPLUG_PCI_ACPI=y
CONFIG_PCI_AARDVARK=n
CONFIG_PCI_TEGRA=n
CONFIG_PCIE_RCAR=n
CONFIG_PCI_HOST_GENERIC=y
CONFIG_PCIE_ALTERA=n
CONFIG_PCIE_ALTERA_MSI=n
CONFIG_PCI_HOST_THUNDER_PEM=n
CONFIG_PCIE_ROCKCHIP_HOST=n
CONFIG_PCI_LAYERSCAPE=n
CONFIG_PCIE_QCOM=n
CONFIG_PCIE_ARMADA_8K=y
CONFIG_PCIE_HISI_STB=n
CONFIG_DEVTMPFS=y
CONFIG_DEVTMPFS_MOUNT=y
CONFIG_TMPFS=y
CONFIG_TMPFS_POSIX_ACL=y
CONFIG_TMPFS_XATTR=y
CONFIG_FW_LOADER_USER_HELPER=y
CONFIG_FW_LOADER_USER_HELPER_FALLBACK=y
CONFIG_HISILICON_LPC=n
CONFIG_SIMPLE_PM_BUS=y
CONFIG_MTD=y
CONFIG_MTD_BLOCK=y
CONFIG_MTD_RAW_NAND=y
CONFIG_MTD_NAND_DENALI_DT=y
CONFIG_MTD_NAND_MARVELL=y
CONFIG_MTD_NAND_QCOM=y
CONFIG_MTD_SPI_NOR=y
CONFIG_BLK_DEV_LOOP=y
CONFIG_BLK_DEV_NBD=m
CONFIG_VIRTIO_BLK=y
CONFIG_SRAM=y
CONFIG_EEPROM_AT25=m
# CONFIG_SCSI_PROC_FS is not set
CONFIG_BLK_DEV_SD=y
CONFIG_SCSI_SAS_ATA=n
CONFIG_SCSI_HISI_SAS=n
CONFIG_SCSI_HISI_SAS_PCI=n
CONFIG_SCSI_MPT3SAS=n
CONFIG_SCSI_UFSHCD=y
CONFIG_SCSI_UFSHCD_PLATFORM=y
CONFIG_SCSI_UFS_QCOM=n
CONFIG_SCSI_UFS_HISI=n
CONFIG_ATA=n
CONFIG_SATA_AHCI=n
CONFIG_SATA_AHCI_PLATFORM=n
CONFIG_AHCI_CEVA=n
CONFIG_AHCI_MVEBU=n
CONFIG_AHCI_XGENE=n
CONFIG_AHCI_QORIQ=n
CONFIG_SATA_SIL24=n
CONFIG_SATA_RCAR=n
CONFIG_PATA_PLATFORM=n
CONFIG_PATA_OF_PLATFORM=n
CONFIG_NETDEVICES=y
CONFIG_BONDING=y
CONFIG_MACVLAN=m
CONFIG_MACVTAP=m
CONFIG_TUN=y
CONFIG_VETH=m
CONFIG_NET_XGENE=n
CONFIG_ATL1C=n
CONFIG_BNX2X=n
CONFIG_FEC=n
CONFIG_HIX5HD2_GMAC=n
CONFIG_HNS3=n
CONFIG_HNS3_HCLGE=n
CONFIG_HNS3_ENET=n
CONFIG_E1000E=n
CONFIG_IGB=n
CONFIG_IGBVF=n
CONFIG_MVNETA=y
CONFIG_MVPP2=y
CONFIG_QCOM_EMAC=n
CONFIG_RAVB=n
CONFIG_SNI_AVE=n
CONFIG_SNI_NETSEC=n
CONFIG_SFP=y
CONFIG_MESON_GXL_PHY=m
CONFIG_MARVELL_PHY=y
CONFIG_MARVELL_10G_PHY=y
CONFIG_MICREL_PHY=y
CONFIG_AT803X_PHY=m
CONFIG_REALTEK_PHY=m
CONFIG_ROCKCHIP_PHY=y
CONFIG_MDIO_BUS_MUX_MMIOREG=y
CONFIG_USB_PEGASUS=n
CONFIG_USB_RTL8150=n
CONFIG_USB_RTL8152=n
CONFIG_USB_LAN78XX=m
CONFIG_USB_USBNET=y
CONFIG_USB_NET_CDCETHER=m
CONFIG_USB_NET_CDC_NCM=m
CONFIG_USB_NET_DM9601=y
CONFIG_USB_NET_SR9800=y
CONFIG_USB_NET_SMSC75XX=y
CONFIG_USB_NET_SMSC95XX=y
CONFIG_USB_NET_PLUSB=y
CONFIG_USB_NET_MCS7830=y
# CONFIG_USB_NET_CDC_SUBSET is not set
# CONFIG_USB_NET_ZAURUS is not set
# CONFIG_WLAN is not set
CONFIG_INPUT_MATRIXKMAP=y
CONFIG_INPUT_EVDEV=y
CONFIG_KEYBOARD_GPIO=n
CONFIG_KEYBOARD_SNVS_PWRKEY=n
CONFIG_INPUT_TOUCHSCREEN=n
CONFIG_TOUCHSCREEN_ATMEL_MXT=n
CONFIG_INPUT_MISC=y
CONFIG_INPUT_HISI_POWERKEY=n
# CONFIG_SERIO_SERPORT is not set
CONFIG_SERIO_AMBAKMI=n
CONFIG_LEGACY_PTY_COUNT=16
CONFIG_SERIAL_8250=y
CONFIG_SERIAL_8250_CONSOLE=y
CONFIG_SERIAL_8250_EXTENDED=y
CONFIG_SERIAL_8250_SHARE_IRQ=y
CONFIG_SERIAL_8250_BCM2835AUX=n
CONFIG_SERIAL_8250_DW=y
CONFIG_SERIAL_8250_OMAP=n
CONFIG_SERIAL_8250_MT6577=n
CONFIG_SERIAL_8250_UNIPHIER=n
CONFIG_SERIAL_OF_PLATFORM=y
CONFIG_SERIAL_AMBA_PL011=y
CONFIG_SERIAL_AMBA_PL011_CONSOLE=y
CONFIG_SERIAL_MESON=n
CONFIG_SERIAL_MESON_CONSOLE=n
CONFIG_SERIAL_SAMSUNG=n
CONFIG_SERIAL_SAMSUNG_CONSOLE=n
CONFIG_SERIAL_TEGRA=n
CONFIG_SERIAL_TEGRA_TCU=n
CONFIG_SERIAL_IMX=n
CONFIG_SERIAL_IMX_CONSOLE=n
CONFIG_SERIAL_SH_SCI=y
CONFIG_SERIAL_MSM=n
CONFIG_SERIAL_MSM_CONSOLE=n
CONFIG_SERIAL_QCOM_GENI=n
CONFIG_SERIAL_QCOM_GENI_CONSOLE=n
CONFIG_SERIAL_XILINX_PS_UART=n
CONFIG_SERIAL_XILINX_PS_UART_CONSOLE=n
CONFIG_SERIAL_FSL_LPUART=n
CONFIG_SERIAL_FSL_LPUART_CONSOLE=n
CONFIG_SERIAL_MVEBU_UART=y
CONFIG_SERIAL_DEV_BUS=y
CONFIG_VIRTIO_CONSOLE=n
CONFIG_IPMI_HANDLER=n
CONFIG_IPMI_DEVICE_INTERFACE=n
CONFIG_IPMI_SI=n
CONFIG_TCG_TPM=n
CONFIG_TCG_TIS_I2C_INFINEON=n
#
# I2C support
#
CONFIG_I2C=y
CONFIG_I2C_BOARDINFO=y
CONFIG_I2C_COMPAT=y
CONFIG_I2C_CHARDEV=y
CONFIG_I2C_MUX=y
CONFIG_I2C_MUX_PCA954x=y
CONFIG_I2C_BCM2835=n
CONFIG_I2C_DESIGNWARE_PLATFORM=y
CONFIG_I2C_GPIO=m
CONFIG_I2C_IMX=n
CONFIG_I2C_IMX_LPI2C=n
CONFIG_I2C_MESON=n
CONFIG_I2C_MV64XXX=y
CONFIG_I2C_PXA=n
CONFIG_I2C_QCOM_GENI=n
CONFIG_I2C_QUP=n
CONFIG_I2C_RK3X=n
CONFIG_I2C_SH_MOBILE=n
CONFIG_I2C_TEGRA=n
CONFIG_I2C_UNIPHIER_F=n
CONFIG_I2C_RCAR=n
CONFIG_SPI=y
CONFIG_SPI_ARMADA_3700=y
CONFIG_SPI_BCM2835=n
CONFIG_SPI_BCM2835AUX=n
CONFIG_SPI_NXP_FLEXSPI=n
CONFIG_SPI_IMX=n
CONFIG_SPI_MESON_SPICC=n
CONFIG_SPI_MESON_SPIFC=n
CONFIG_SPI_ORION=y
CONFIG_SPI_PL022=y
CONFIG_SPI_ROCKCHIP=n
CONFIG_SPI_QUP=n
CONFIG_SPI_S3C64XX=n
CONFIG_SPI_SUN6I=n
CONFIG_SPI_SPIDEV=m
CONFIG_PINCTRL_SINGLE=y
CONFIG_PINCTRL_IMX8MM=n
CONFIG_PINCTRL_IMX8MN=n
CONFIG_PINCTRL_IMX8MQ=n
CONFIG_PINCTRL_IMX8QXP=n
CONFIG_PINCTRL_IPQ8074=n
CONFIG_PINCTRL_MSM8916=n
CONFIG_PINCTRL_MSM8994=n
CONFIG_PINCTRL_MSM8996=n
CONFIG_PINCTRL_MSM8998=n
CONFIG_PINCTRL_QCS404=n
CONFIG_PINCTRL_QDF2XXX=n
CONFIG_PINCTRL_SDM845=n
CONFIG_PINCTRL_SM8150=n
CONFIG_GPIO_DWAPB=y
CONFIG_GPIO_MB86S7X=n
CONFIG_GPIO_PL061=y
CONFIG_GPIO_RCAR=n
CONFIG_GPIO_UNIPHIER=n
CONFIG_GPIO_XGENE=n
CONFIG_GPIO_XGENE_SB=n
CONFIG_GPIO_MAX732X=y
CONFIG_GPIO_PCA953X=y
CONFIG_GPIO_PCA953X_IRQ=y
CONFIG_POWER_RESET_MSM=n
CONFIG_POWER_RESET_XGENE=n
CONFIG_POWER_RESET_SYSCON=y
CONFIG_SYSCON_REBOOT_MODE=y
CONFIG_BATTERY_SBS=m
CONFIG_BATTERY_BQ27XXX=n
CONFIG_SENSORS_ARM_SCPI=y
CONFIG_SENSORS_LM90=m
CONFIG_SENSORS_RASPBERRYPI_HWMON=n
CONFIG_SENSORS_INA2XX=m
CONFIG_SENSORS_INA3221=m
CONFIG_CPU_THERMAL=y
CONFIG_THERMAL_EMULATION=y
CONFIG_QORIQ_THERMAL=n
CONFIG_ROCKCHIP_THERMAL=n
CONFIG_RCAR_THERMAL=n
CONFIG_RCAR_GEN3_THERMAL=n
CONFIG_ARMADA_THERMAL=y
CONFIG_BCM2835_THERMAL=n
CONFIG_BRCMSTB_THERMAL=n
CONFIG_EXYNOS_THERMAL=n
CONFIG_TEGRA_BPMP_THERMAL=n
CONFIG_QCOM_TSENS=n
CONFIG_UNIPHIER_THERMAL=n
CONFIG_WATCHDOG=y
CONFIG_ARM_SP805_WATCHDOG=y
CONFIG_S3C2410_WATCHDOG=n
CONFIG_DW_WATCHDOG=y
CONFIG_SUNXI_WATCHDOG=n
CONFIG_IMX2_WDT=n
CONFIG_IMX_SC_WDT=n
CONFIG_MESON_GXBB_WATCHDOG=n
CONFIG_MESON_WATCHDOG=n
CONFIG_RENESAS_WDT=n
CONFIG_UNIPHIER_WATCHDOG=n
CONFIG_BCM2835_WDT=n
CONFIG_MFD_ALTERA_SYSMGR=n
CONFIG_MFD_BD9571MWV=n
CONFIG_MFD_AXP20X_I2C=n
CONFIG_MFD_AXP20X_RSB=n
CONFIG_MFD_EXYNOS_LPASS=n
CONFIG_MFD_HI655X_PMIC=n
CONFIG_MFD_ROHM_BD718XX=n
CONFIG_REGULATOR_AXP20X=n
CONFIG_REGULATOR_BD718XX=n
CONFIG_REGULATOR_BD9571MWV=n
CONFIG_REGULATOR_HI655X=n
CONFIG_REGULATOR_MAX8973=y
CONFIG_REGULATOR_PFUZE100=n
CONFIG_REGULATOR_QCOM_RPMH=n
CONFIG_REGULATOR_QCOM_SMD_RPM=n
CONFIG_REGULATOR_VCTRL=m
CONFIG_RC_CORE=m
CONFIG_RC_DECODERS=y
CONFIG_RC_DEVICES=y
CONFIG_IR_MESON=n
CONFIG_IR_SUNXI=n
CONFIG_MEDIA_SUPPORT=n
CONFIG_MEDIA_CAMERA_SUPPORT=n
CONFIG_MEDIA_ANALOG_TV_SUPPORT=n
CONFIG_MEDIA_DIGITAL_TV_SUPPORT=n
CONFIG_VIDEO_V4L2_SUBDEV_API=n
# CONFIG_DVB_NET is not set
CONFIG_MEDIA_USB_SUPPORT=n
CONFIG_USB_VIDEO_CLASS=n
CONFIG_DRM=n
CONFIG_DRM_I2C_NXP_TDA998X=n
CONFIG_DRM_NOUVEAU=n
CONFIG_DRM_EXYNOS=n
CONFIG_DRM_EXYNOS5433_DECON=n
CONFIG_DRM_EXYNOS7_DECON=n
CONFIG_DRM_EXYNOS_DSI=n
# CONFIG_DRM_EXYNOS_DP is not set
CONFIG_DRM_EXYNOS_HDMI=n
CONFIG_DRM_EXYNOS_MIC=n
CONFIG_DRM_ROCKCHIP=n
CONFIG_ROCKCHIP_ANALOGIX_DP=n
CONFIG_ROCKCHIP_CDN_DP=n
CONFIG_ROCKCHIP_DW_HDMI=n
CONFIG_ROCKCHIP_DW_MIPI_DSI=n
CONFIG_ROCKCHIP_INNO_HDMI=n
CONFIG_DRM_RCAR_DU=n
CONFIG_DRM_SUN4I=n
CONFIG_DRM_SUN8I_DW_HDMI=n
CONFIG_DRM_SUN8I_MIXER=n
CONFIG_DRM_MSM=n
CONFIG_DRM_TEGRA=n
CONFIG_DRM_PANEL_SIMPLE=n
CONFIG_DRM_SII902X=n
CONFIG_DRM_I2C_ADV7511=n
CONFIG_DRM_ETNAVIV=n
CONFIG_DRM_HISI_HIBMC=n
CONFIG_DRM_HISI_KIRIN=n
CONFIG_DRM_MESON=n
CONFIG_DRM_PL111=n
CONFIG_DRM_LIMA=n
CONFIG_DRM_PANFROST=n
CONFIG_FB=n
CONFIG_FB_MODE_HELPERS=n
CONFIG_FB_EFI=n
CONFIG_I2C_HID=n
CONFIG_USB=y
CONFIG_USB_OTG=n
CONFIG_USB_XHCI_HCD=y
CONFIG_USB_XHCI_TEGRA=n
CONFIG_USB_EHCI_HCD=y
CONFIG_USB_EHCI_ROOT_HUB_TT=y
CONFIG_USB_EHCI_EXYNOS=n
CONFIG_USB_EHCI_HCD_PLATFORM=y
CONFIG_USB_OHCI_HCD=y
CONFIG_USB_OHCI_EXYNOS=n
CONFIG_USB_OHCI_HCD_PLATFORM=y
CONFIG_USB_RENESAS_USBHS=n
CONFIG_USB_STORAGE=y
CONFIG_USB_MUSB_HDRC=y
CONFIG_USB_MUSB_SUNXI=n
CONFIG_USB_DWC3=y
CONFIG_USB_DWC3_HOST=y
CONFIG_USB_DWC2=y
CONFIG_USB_DWC2_HOST=y
CONFIG_USB_CHIPIDEA=y
CONFIG_USB_CHIPIDEA_UDC=y
CONFIG_NOP_USB_XCEIV=y
CONFIG_USB_GADGET=y
CONFIG_USB_RENESAS_USBHS_UDC=n
CONFIG_USB_RENESAS_USB3=n
CONFIG_USB_CONFIGFS=y
CONFIG_USB_CONFIGFS_SERIAL=y
CONFIG_USB_CONFIGFS_ACM=y
CONFIG_USB_CONFIGFS_OBEX=y
CONFIG_USB_CONFIGFS_MASS_STORAGE=y
CONFIG_USB_G_SERIAL=y
CONFIG_TYPEC=m
CONFIG_MMC=y
CONFIG_MMC_BLOCK_MINORS=32
CONFIG_MMC_ARMMMCI=y
CONFIG_MMC_SDHCI=y
CONFIG_MMC_SDHCI_ACPI=y
CONFIG_MMC_SDHCI_PLTFM=y
CONFIG_MMC_SDHCI_OF_ARASAN=n
CONFIG_MMC_SDHCI_OF_ESDHC=y
CONFIG_MMC_SDHCI_CADENCE=y
CONFIG_MMC_SDHCI_ESDHC_IMX=n
CONFIG_MMC_SDHCI_TEGRA=n
CONFIG_MMC_SDHCI_F_SDH30=y
CONFIG_MMC_MESON_GX=n
CONFIG_MMC_SDHCI_MSM=n
CONFIG_MMC_SPI=y
CONFIG_MMC_SDHI=y
CONFIG_MMC_UNIPHIER=n
CONFIG_MMC_DW=y
CONFIG_MMC_DW_EXYNOS=n
CONFIG_MMC_DW_HI3798CV200=n
CONFIG_MMC_DW_K3=n
CONFIG_MMC_DW_ROCKCHIP=n
CONFIG_MMC_SUNXI=n
CONFIG_MMC_BCM2835=n
CONFIG_MMC_SDHCI_XENON=y
CONFIG_NEW_LEDS=y
CONFIG_LEDS_CLASS=y
CONFIG_LEDS_GPIO=y
CONFIG_LEDS_SYSCON=y
CONFIG_LEDS_TRIGGER_DISK=y
CONFIG_LEDS_TRIGGER_HEARTBEAT=y
CONFIG_LEDS_TRIGGER_CPU=y
CONFIG_LEDS_TRIGGER_DEFAULT_ON=y
CONFIG_LEDS_TRIGGER_PANIC=y
CONFIG_EDAC=y
CONFIG_RTC_CLASS=y
CONFIG_RTC_DRV_RX8581=n
CONFIG_RTC_DRV_DS3232=n
CONFIG_RTC_DRV_S3C=n
CONFIG_RTC_DRV_PL031=y
CONFIG_RTC_DRV_SUN6I=n
CONFIG_RTC_DRV_ARMADA38X=y
CONFIG_RTC_DRV_TEGRA=n
CONFIG_RTC_DRV_SNVS=n
CONFIG_RTC_DRV_IMX_SC=n
CONFIG_RTC_DRV_XGENE=n
CONFIG_DMADEVICES=y
CONFIG_DMA_BCM2835=n
CONFIG_DMA_SUN6I=n
CONFIG_FSL_EDMA=n
CONFIG_IMX_SDMA=n
CONFIG_K3_DMA=n
CONFIG_MV_XOR=y
CONFIG_MV_XOR_V2=y
CONFIG_PL330_DMA=y
CONFIG_TEGRA20_APB_DMA=n
CONFIG_QCOM_BAM_DMA=n
CONFIG_RCAR_DMAC=n
CONFIG_RENESAS_USB_DMAC=n
CONFIG_UIO=y
CONFIG_UIO_PDRV_GENIRQ=m
CONFIG_VFIO=y
CONFIG_VFIO_PCI=y
CONFIG_VIRTIO_PCI=y
CONFIG_VIRTIO_BALLOON=y
CONFIG_VIRTIO_MMIO=y
CONFIG_COMMON_CLK_SCPI=y
CONFIG_COMMON_CLK_CS2000_CP=y
CONFIG_CLK_QORIQ=n
CONFIG_CLK_RASPBERRYPI=n
CONFIG_CLK_IMX8MM=n
CONFIG_CLK_IMX8MN=n
CONFIG_CLK_IMX8MQ=n
CONFIG_CLK_IMX8QXP=n
CONFIG_TI_SCI_CLK=n
CONFIG_COMMON_CLK_QCOM=n
CONFIG_QCOM_A53PLL=n
CONFIG_QCOM_CLK_APCS_MSM8916=n
CONFIG_QCOM_CLK_SMD_RPM=y
CONFIG_QCOM_CLK_RPMH=y
CONFIG_IPQ_GCC_8074=n
CONFIG_MSM_GCC_8916=n
CONFIG_MSM_GCC_8994=n
CONFIG_MSM_MMCC_8996=n
CONFIG_MSM_GCC_8998=n
CONFIG_QCS_GCC_404=n
CONFIG_SDM_GCC_845=n
CONFIG_SM_GCC_8150=n
CONFIG_HWSPINLOCK=y
CONFIG_HWSPINLOCK_QCOM=n
CONFIG_ARM_MHU=y
CONFIG_IMX_MBOX=n
CONFIG_PLATFORM_MHU=y
CONFIG_BCM2835_MBOX=n
CONFIG_QCOM_APCS_IPC=n
CONFIG_ROCKCHIP_IOMMU=n
CONFIG_TEGRA_IOMMU_SMMU=n
CONFIG_ARM_SMMU=y
CONFIG_ARM_SMMU_V3=y
CONFIG_QCOM_IOMMU=n
CONFIG_REMOTEPROC=y
CONFIG_QCOM_Q6V5_MSS=n
CONFIG_QCOM_Q6V5_PAS=n
CONFIG_QCOM_SYSMON=n
CONFIG_RPMSG_QCOM_GLINK_RPM=n
CONFIG_RPMSG_QCOM_GLINK_SMEM=n
CONFIG_RPMSG_QCOM_SMD=n
CONFIG_RASPBERRYPI_POWER=n
CONFIG_QCOM_GENI_SE=n
CONFIG_QCOM_RPMH=n
CONFIG_QCOM_SMEM=n
CONFIG_QCOM_SMD_RPM=n
CONFIG_QCOM_SMP2P=n
CONFIG_QCOM_SMSM=n
CONFIG_ARCH_R8A77995=n
CONFIG_ARCH_R8A77990=n
CONFIG_ARCH_R8A77965=n
CONFIG_ARCH_R8A77980=n
CONFIG_ARCH_R8A77970=n
CONFIG_ARCH_R8A774C0=n
CONFIG_ARCH_R8A774A1=n
CONFIG_ROCKCHIP_IODOMAIN=n
CONFIG_ROCKCHIP_PM_DOMAINS=n
CONFIG_ARCH_TEGRA_132_SOC=n
CONFIG_ARCH_TEGRA_210_SOC=n
CONFIG_ARCH_TEGRA_186_SOC=n
CONFIG_ARCH_TEGRA_194_SOC=n
CONFIG_ARCH_K3_AM6_SOC=n
CONFIG_ARCH_K3_J721E_SOC=n
CONFIG_TI_SCI_PM_DOMAINS=n
CONFIG_EXTCON_USB_GPIO=y
CONFIG_MEMORY=y
CONFIG_RESET_TI_SCI=n
CONFIG_PHY_XGENE=n
CONFIG_PHY_SUN4I_USB=n
CONFIG_PHY_HI6220_USB=y
CONFIG_PHY_HISTB_COMBPHY=n
CONFIG_PHY_HISI_INNO_USB2=y
CONFIG_PHY_MVEBU_CP110_COMPHY=y
CONFIG_PHY_QCOM_QMP=n
CONFIG_PHY_QCOM_QUSB2=n
CONFIG_PHY_QCOM_USB_HS=n
CONFIG_PHY_RCAR_GEN3_PCIE=n
CONFIG_PHY_RCAR_GEN3_USB2=n
CONFIG_PHY_RCAR_GEN3_USB3=n
CONFIG_PHY_ROCKCHIP_EMMC=n
CONFIG_PHY_ROCKCHIP_INNO_HDMI=n
CONFIG_PHY_ROCKCHIP_INNO_USB2=n
CONFIG_PHY_ROCKCHIP_PCIE=n
CONFIG_PHY_ROCKCHIP_TYPEC=n
CONFIG_PHY_UNIPHIER_USB2=n
CONFIG_PHY_UNIPHIER_USB3=n
CONFIG_PHY_TEGRA_XUSB=n
CONFIG_FSL_IMX8_DDR_PMU=n
CONFIG_QCOM_L2_PMU=n
CONFIG_QCOM_L3_PMU=n
CONFIG_HISI_PMU=n
CONFIG_NVMEM_IMX_OCOTP=n
CONFIG_NVMEM_IMX_OCOTP_SCU=n
CONFIG_QCOM_QFPROM=n
CONFIG_ROCKCHIP_EFUSE=n
CONFIG_NVMEM_SUNXI_SID=n
CONFIG_UNIPHIER_EFUSE=n
CONFIG_MESON_EFUSE=n
CONFIG_FPGA=n
CONFIG_FPGA_MGR_STRATIX10_SOC=n
CONFIG_FPGA_BRIDGE=n
CONFIG_ALTERA_FREEZE_BRIDGE=n
CONFIG_FPGA_REGION=n
CONFIG_OF_FPGA_REGION=n
CONFIG_OF=y
# CONFIG_OF_UNITTEST is not set
CONFIG_OF_FLATTREE=y
CONFIG_OF_EARLY_FLATTREE=y
CONFIG_OF_KOBJ=y
CONFIG_OF_DYNAMIC=y
CONFIG_OF_ADDRESS=y
CONFIG_OF_IRQ=y
CONFIG_OF_NET=y
CONFIG_OF_RESERVED_MEM=y
CONFIG_OF_RESOLVE=y
CONFIG_OF_OVERLAY=y
CONFIG_TEE=y
CONFIG_EXT2_FS=m
CONFIG_EXT3_FS=y
CONFIG_EXT4_FS_POSIX_ACL=y
CONFIG_BTRFS_FS=n
CONFIG_BTRFS_FS_POSIX_ACL=n
CONFIG_FANOTIFY=y
CONFIG_FANOTIFY_ACCESS_PERMISSIONS=y
CONFIG_QUOTA=y
CONFIG_AUTOFS4_FS=y
CONFIG_FUSE_FS=m
CONFIG_CUSE=m
CONFIG_OVERLAY_FS=m
CONFIG_VFAT_FS=y
CONFIG_HUGETLBFS=y
CONFIG_SQUASHFS=n
CONFIG_NFS_FS=y
CONFIG_NFS_V4=y
CONFIG_NFS_V4_1=y
CONFIG_NFS_V4_2=y
CONFIG_ROOT_NFS=y
CONFIG_9P_FS=n
CONFIG_NLS_CODEPAGE_437=y
CONFIG_NLS_ISO8859_1=y
CONFIG_SECURITY=y
CONFIG_CRYPTO_AUTHENC=y
CONFIG_CRYPTO_ECHAINIV=y
CONFIG_CRYPTO_CBC=y
CONFIG_CRYPTO_MD5=y
CONFIG_CRYPTO_SHA512=y
CONFIG_CRYPTO_DES=n
CONFIG_CRYPTO_ANSI_CPRNG=y
CONFIG_CRYPTO_DEV_SAFEXCEL=m
CONFIG_LIBCRC32C=y
CONFIG_CMA_SIZE_MBYTES=0
CONFIG_PRINTK_TIME=y
CONFIG_DEBUG_INFO=y
CONFIG_MAGIC_SYSRQ=y
CONFIG_DEBUG_FS=y
CONFIG_DEBUG_KERNEL=y
CONFIG_PANIC_TIMEOUT=1
CONFIG_SCHED_DEBUG=y
CONFIG_SCHED_INFO=y
CONFIG_SCHEDSTATS=y

# CONFIG_DEBUG_PREEMPT is not set
CONFIG_STACKTRACE=y
# CONFIG_FTRACE is not set
CONFIG_MEMTEST=y
```
