## Config.in
```kconfig
source "$BR2_EXTERNAL_PRESTERA_PATH/package/Config.in"
source "$BR2_EXTERNAL_PRESTERA_PATH/toolchain/toolchain-external-marvell-arm-aarch64/Config.in.options"

config BR2_PRESTERA_BOARD_NAME
	string "Prestera board name"

config BR2_PRESTERA_BASE_PACKAGES
	bool "select basic set of packages"

	select BR2_PACKAGE_PRESTERA_IPROUTE2
	select BR2_PACKAGE_IPTABLES
	select BR2_PACKAGE_PCIUTILS
	select BR2_PACKAGE_TCPDUMP
	select BR2_PACKAGE_ETHTOOL
	select BR2_PACKAGE_NETSNIFF_NG
	select BR2_PACKAGE_IPUTILS
	select BR2_PACKAGE_DHCP
	select BR2_PACKAGE_DHCP_CLIENT
	select BR2_PACKAGE_DNSMASQ
	select BR2_PACKAGE_DNSMASQ_DHCP
	select BR2_PACKAGE_BRIDGE_UTILS
	select BR2_PACKAGE_STRESS_NG
	select BR2_PACKAGE_IPERF
	select BR2_PACKAGE_IPERF3
	select BR2_PACKAGE_FRR
	select BR2_PACKAGE_COREUTILS
	select BR2_PACKAGE_OPEN_LLDP
	select BR2_PACKAGE_MSTPD
	select BR2_PACKAGE_KEEPALIVED
	select BR2_PACKAGE_UTIL_LINUX
	select BR2_PACKAGE_UTIL_LINUX_LIBUUID
	select BR2_PACKAGE_UTIL_LINUX_BINARIES

	select BR2_PACKAGE_BASH
	select BR2_PACKAGE_SUDO
	select BR2_PACKAGE_OPENSSH

	select BR2_PACKAGE_LLDPD
	select BR2_PACKAGE_LLDPD_CDP
	select BR2_PACKAGE_LLDPD_FDP
	select BR2_PACKAGE_LLDPD_EDP
	select BR2_PACKAGE_LLDPD_SONMP
	select BR2_PACKAGE_LLDPD_LLDPMED
	select BR2_PACKAGE_LLDPD_DOT1
	select BR2_PACKAGE_LLDPD_DOT3
	select BR2_PACKAGE_LLDPD_CUSTOM_TLV

	select BR2_PACKAGE_PRESTERA_UTILS

# overriden options
if BR2_PACKAGE_BUSYBOX

config BR2_PACKAGE_BUSYBOX_SHOW_OTHERS
	default y
config BR2_PACKAGE_BUSYBOX_CONFIG_FRAGMENT_FILES
	default "$(BR2_EXTERNAL_PRESTERA_PATH)/board/common/busybox.config"

endif
```
