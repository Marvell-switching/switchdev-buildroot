## configs/a7k_swdev_defconfig
```kconfig
# Architecture
BR2_aarch64=y
BR2_cortex_a72=y

# Toolchain
BR2_TOOLCHAIN_EXTERNAL=y
BR2_TOOLCHAIN_EXTERNAL_ARM_AARCH64=y

BR2_PACKAGE_HOST_LINUX_HEADERS_CUSTOM_5_2=y

BR2_GLOBAL_PATCH_DIR="$(BR2_EXTERNAL_PRESTERA_PATH)/patches/linux/5.15.11"

# Kernel
BR2_LINUX_KERNEL=y
BR2_LINUX_KERNEL_USE_CUSTOM_CONFIG=y
BR2_LINUX_KERNEL_CUSTOM_CONFIG_FILE="$(BR2_EXTERNAL_PRESTERA_PATH)/board/common/a7k/linux.config"
BR2_LINUX_KERNEL_CONFIG_FRAGMENT_FILES="$(BR2_EXTERNAL_PRESTERA_PATH)/board/common/linux-prestera.config"
BR2_LINUX_KERNEL_DTS_SUPPORT=y
BR2_LINUX_KERNEL_INTREE_DTS_NAME="marvell/armada-7040-db"
BR2_LINUX_KERNEL_PATCH="$(BR2_EXTERNAL_PRESTERA_PATH)/patches/linux/5.15.11"
BR2_LINUX_KERNEL_LATEST_VERSION=n
BR2_LINUX_KERNEL_CUSTOM_VERSION=y
BR2_LINUX_KERNEL_VERSION="5.15.11"
BR2_LINUX_KERNEL_CUSTOM_VERSION_VALUE="5.15.11"

# System
BR2_SYSTEM_BIN_SH_BASH=y
BR2_TARGET_GENERIC_GETTY_PORT="ttyS0"
BR2_TARGET_GENERIC_HOSTNAME="amzgo-host"

# Rootfs
BR2_ROOTFS_DEVICE_CREATION_DYNAMIC_EUDEV=y
BR2_TARGET_ROOTFS_EXT2=y
BR2_TARGET_ROOTFS_EXT2_4=y
BR2_TARGET_ROOTFS_EXT2_SIZE="140M"

# Packages

# Connection tracking
BR2_PACKAGE_CONNTRACK_TOOLS=y

# Prestera
BR2_PACKAGE_CPSS=y
BR2_PACKAGE_PRESTERA_DRIVER=y
BR2_PACKAGE_PLATFORM_DRIVERS=y
BR2_PACKAGE_PLAT_GPIO_I2C=y
BR2_PACKAGE_PRESTERA_SYSTEM=y
BR2_PACKAGE_PRESTERA_FW_VENDOR_STRING="marvell"
BR2_PACKAGE_PRESTERA_FW=y
BR2_PACKAGE_PRESTERA_FW_VERSION="3.1.2"
BR2_PACKAGE_PRESTERA_FW_INSTALL_SUBDIR="marvell"
BR2_PACKAGE_PRESTERA_FW_FLASH=y
# changes/fixes/scripts needed by QA
BR2_PACKAGE_PRESTERA_QA=y
BR2_PACKAGE_PRESTERA_SSH=y

BR2_PRESTERA_BASE_PACKAGES=y

BR2_PACKAGE_E2FSPROGS=y
BR2_PACKAGE_E2FSPROGS_RESIZE2FS=y

BR2_PACKAGE_LM_SENSORS=y
BR2_PACKAGE_LM_SENSORS_SENSORS=y
BR2_PACKAGE_LM_SENSORS_PWMCONFIG=y
BR2_PACKAGE_LM_SENSORS_FANCONTROL=y

BR2_PACKAGE_LINUX_TOOLS=y
BR2_PACKAGE_LINUX_TOOLS_SELFTESTS=y

BR2_PACKAGE_NUMACTL=y
BR2_PACKAGE_JQ=y

# Required tools to create the SD image
BR2_PACKAGE_HOST_DOSFSTOOLS=y
BR2_PACKAGE_HOST_GENIMAGE=y
BR2_PACKAGE_HOST_MTOOLS=y

BR2_ROOTFS_POST_IMAGE_SCRIPT="$(BR2_EXTERNAL_PRESTERA_PATH)/board/common/a7k/post-image.sh"
```

## configs/ac5x_trampoline_min_defconfig
```kconfig
# Architecture
BR2_aarch64=y
BR2_cortex_a72=y
BR2_ENABLE_DEBUG=n

# Toolchain
BR2_TOOLCHAIN_EXTERNAL=y
BR2_TOOLCHAIN_EXTERNAL_ARM_AARCH64=y

BR2_PACKAGE_HOST_LINUX_HEADERS_CUSTOM_5_2=y

#BR2_GLOBAL_PATCH_DIR="$(BR2_EXTERNAL_PRESTERA_PATH)/patches/swdev/host"

# Kernel
BR2_LINUX_KERNEL=y
BR2_LINUX_KERNEL_CUSTOM_VERSION=n
#BR2_LINUX_KERNEL_CUSTOM_VERSION_VALUE="5.15.11"
BR2_LINUX_KERNEL_CUSTOM_TARBALL=n
BR2_LINUX_KERNEL_CUSTOM_GIT=y
BR2_LINUX_KERNEL_CUSTOM_REPO_URL="https://github.com/Marvell-switching/linux"
BR2_LINUX_KERNEL_CUSTOM_REPO_VERSION="686f3f29dd06e1fbdf687c9b49a76a8476caf78e"
BR2_LINUX_KERNEL_USE_DEFCONFIG=n
BR2_LINUX_KERNEL_USE_ARCH_DEFAULT_CONFIG=n
BR2_LINUX_KERNEL_USE_CUSTOM_CONFIG=y

BR2_LINUX_KERNEL_CUSTOM_CONFIG_FILE="$(BR2_EXTERNAL_PRESTERA_PATH)/board/marvell/marvell_v8_sdk_swdev515_defconfig"
#BR2_LINUX_KERNEL_CONFIG_FRAGMENT_FILES="$(BR2_EXTERNAL_PRESTER
#A_PATH)/board/common/ac5x/trampoline-linux.cfg"

BR2_LINUX_KERNEL_DTS_SUPPORT=y
BR2_LINUX_KERNEL_CUSTOM_DTS_INTREE_SUBDIR="marvell"
BR2_LINUX_KERNEL_CUSTOM_DTS_PATH="$(BR2_EXTERNAL_PRESTERA_PATH)/board/marvell/ac5_as4564_trampoline.dts"
BR2_LINUX_KERNEL_LATEST_VERSION=n
BR2_LINUX_KERNEL_VERSION=5.15.11
BR2_LINUX_KERNEL_CUSTOM_VERSION_VALUE=5.15.11
BR2_LINUX_KERNEL_CUSTOM_VERSION=n

# System
BR2_SYSTEM_BIN_SH_BASH=n
BR2_PACKAGE_BUSYBOX_SHOW_OTHERS=n
BR2_PACKAGE_SRL=n
BR2_PACKAGE_BASH_STATIC=n
BR2_TARGET_GENERIC_GETTY_PORT="ttyS0"
BR2_TARGET_GENERIC_HOSTNAME="trampoline"

# Rootfs
BR2_ROOTFS_OVERLAY="$(BR2_EXTERNAL_PRESTERA_PATH)/board/accton/asic/as4564_26p_ac5x_trampoline/rootfs-overlay"
BR2_ROOTFS_DEVICE_CREATION_DYNAMIC_EUDEV=y
BR2_TARGET_ROOTFS_INITRAMFS=y
BR2_TARGET_ROOTFS_CPIO=y
BR2_TARGET_ROOTFS_CPIO_GZIP=y
BR2_TARGET_ROOTFS_CPIO_UIMAGE=y
BR2_TARGET_ROOTFS_EXT2=y
BR2_TARGET_ROOTFS_EXT2_4=y
BR2_TARGET_ROOTFS_EXT2_SIZE="256M"

# Packages

# Connection tracking
BR2_PACKAGE_CONNTRACK_TOOLS=y

# Prestera
BR2_PACKAGE_PRESTERA_DRIVER=y
BR2_PACKAGE_PLATFORM_DRIVERS=y
BR2_PACKAGE_PRESTERA_DRIVER_IPC_TRAMPOLINE=y
BR2_PACKAGE_CPSS=y
BR2_PACKAGE_CPSS_PRESTERA_SWDEV_KMOD=y
BR2_PACKAGE_CPSS_DRIVERS_KMOD=y
BR2_PACKAGE_CPSS_PRESTERA_SWDEV_IPC_PCI=n
BR2_PACKAGE_CPSS_PRESTERA_SWDEV_IPC_TRAMPOLINE=y
BR2_PACKAGE_CPSS_PRESTERA_SWDEV_PLAT_GPIO_I2C=y
BR2_PACKAGE_CPSS_PRESTERA_SWDEV_PLAT_TN48XXM_CPLD=n
BR2_PACKAGE_CPSS_PRESTERA_SWDEV_PLAT_AS5114_48X_CPLD=n
BR2_PACKAGE_PLATFORM_DRIVERS=y
BR2_PACKAGE_PLAT_GPIO_I2C=y

BR2_PACKAGE_PRESTERA_SYSTEM=y
BR2_PACKAGE_PRESTERA_FW=y
BR2_PACKAGE_PRESTERA_FW_VERSION="3.1.1"
BR2_PACKAGE_PRESTERA_FW_DEFCONFIG="a38x_fw_bin ac5x_fw_bin"
BR2_PACKAGE_PRESTERA_FW_FLASH=y
# changes/fixes/scripts needed by QA
BR2_PACKAGE_PRESTERA_QA=y
BR2_PACKAGE_PRESTERA_SSH=y

BR2_PACKAGE_HOST_GDB=n
BR2_PACKAGE_GDB=n
BR2_PACKAGE_GDB_SERVER=n

BR2_PACKAGE_IFUPDOWN=y
BR2_PACKAGE_IFUPDOWN_SCRIPTS=y

BR2_PRESTERA_BASE_PACKAGES=y

BR2_PACKAGE_E2FSPROGS=y
BR2_PACKAGE_E2FSPROGS_RESIZE2FS=y

BR2_PACKAGE_LM_SENSORS=y
BR2_PACKAGE_LM_SENSORS_SENSORS=y
BR2_PACKAGE_LM_SENSORS_PWMCONFIG=y
BR2_PACKAGE_LM_SENSORS_FANCONTROL=y

BR2_PACKAGE_LINUX_TOOLS=y
BR2_PACKAGE_LINUX_TOOLS_SELFTESTS=y

BR2_PACKAGE_NUMACTL=n
BR2_PACKAGE_JQ=n

# Required tools to create the SD image
BR2_PACKAGE_HOST_DOSFSTOOLS=y
BR2_PACKAGE_HOST_GENIMAGE=y
BR2_PACKAGE_HOST_MTOOLS=y
BR2_PACKAGE_PCRE=y
BR2_PACKAGE_PCRE2=y
BR2_PACKAGE_LIGHTTPD=y

BR2_PACKAGE_CPSS=y
BR2_PACKAGE_CPSS_AGENT=y
BR2_PACKAGE_CPSS_AGENT_DEBUG_INFO=n
BR2_PACKAGE_CPSS_AGENT_SWDEV_PCI=y
BR2_PACKAGE_CPSS_AGENT_SWDEV_IPC_ADDR="0x212000000"
BR2_PACKAGE_CPSS_AGENT_SWDEV_IPC_SIZE="4194304"
BR2_PACKAGE_CPSS_AGENT_SWDEV_FW_VER="3.1.1"
BR2_PACKAGE_LIBZLIB=y
BR2_PACKAGE_PRESTERA_FW_GEN=y
BR2_PACKAGE_PRESTERA_FW_GEN_SUFFIX="_arm64"

BR2_ROOTFS_POST_IMAGE_SCRIPT="$(BR2_EXTERNAL_PRESTERA_PATH)/board/common/ac5x/post-image-trampoline.sh"
BR2_ROOTFS_POST_BUILD_SCRIPT="$(BR2_EXTERNAL_PRESTERA_PATH)/board/common/ac5x/post-build-trampoline.sh"
```

## package/Config.in
```kconfig
source "$BR2_EXTERNAL_PRESTERA_PATH/package/cpss/Config.in"
source "$BR2_EXTERNAL_PRESTERA_PATH/package/prestera-system/Config.in"
source "$BR2_EXTERNAL_PRESTERA_PATH/package/prestera-frr/Config.in"
source "$BR2_EXTERNAL_PRESTERA_PATH/package/prestera-log/Config.in"
source "$BR2_EXTERNAL_PRESTERA_PATH/package/prestera-qa/Config.in"
source "$BR2_EXTERNAL_PRESTERA_PATH/package/prestera-ssh/Config.in"
source "$BR2_EXTERNAL_PRESTERA_PATH/package/rtrlib/Config.in"
source "$BR2_EXTERNAL_PRESTERA_PATH/package/mstpd/Config.in"
source "$BR2_EXTERNAL_PRESTERA_PATH/package/iniparser/Config.in.host"
source "$BR2_EXTERNAL_PRESTERA_PATH/package/date-fixup/Config.in"
source "$BR2_EXTERNAL_PRESTERA_PATH/package/prestera-iproute2/Config.in"
source "$BR2_EXTERNAL_PRESTERA_PATH/package/prestera-driver/Config.in"
source "$BR2_EXTERNAL_PRESTERA_PATH/package/platform-drivers/Config.in"
```

## package/cpss/Config.in
```kconfig
config BR2_PACKAGE_CPSS
	bool "cpss"
	depends on BR2_TOOLCHAIN_HAS_THREADS
	help
	  Marvell's Prestera SDK

config BR2_PACKAGE_CPSS_SRC
	bool "cpss"
	depends on BR2_TOOLCHAIN_HAS_THREADS
	help
	  Build Marvell's Prestera SDK from Source, only for customers with special agreement which has this source

config BR2_PACKAGE_CPSS_USE_CUSTOM_VERSION
	bool "use cpss from custom git version"

config BR2_PACKAGE_CPSS_CUSTOM_VERSION
	string "pull cpss from specified git commit"

if BR2_PACKAGE_CPSS

source "$BR2_EXTERNAL_PRESTERA_PATH/package/cpss/cpss-drivers-kmod/Config.in"

endif

if BR2_PACKAGE_CPSS_SRC
source "$BR2_EXTERNAL_PRESTERA_PATH/package/cpss/cpss-agent-src/Config.in"
endif

if !BR2_PACKAGE_CPSS_SRC
source "$BR2_EXTERNAL_PRESTERA_PATH/package/cpss/cpss-agent/Config.in"
endif
```

## package/cpss/cpss-agent-src/Config.in
```kconfig
config BR2_PACKAGE_CPSS_AGENT_SRC
	bool "cpss-AGENT_SRC"
	select BR2_PACKAGE_LIBNL if !BR2_PACKAGE_CPSS_AGENT_SRC_SWDEV_PCI
	select BR2_PACKAGE_LIBARCHIVE
	help
	  CPSS FW application application

if BR2_PACKAGE_CPSS_AGENT_SRC

config BR2_PACKAGE_CPSS_AGENT_SRC_SWDEV_PCI
	bool "pci-swdev-ipc"
	help
	  Use PCI as communication bus between SwDevAgent and Switchdev.

config BR2_PACKAGE_CPSS_AGENT_SRC_SWDEV_IPC_ADDR
	string "pci-swdev-ipc-addr"
	help
	  Switchdev Agent IPC physical address

config BR2_PACKAGE_CPSS_AGENT_SRC_SWDEV_IPC_SIZE
	string "pci-swdev-ipc-size"
	help
	  Switchdev Agent IPC size

config BR2_PACKAGE_CPSS_AGENT_SRC_SWDEV_TESTS
	bool "pci-swdev-tests"
	help
	  Build FW application with swdev tests

config BR2_PACKAGE_CPSS_AGENT_SRC_SWDEV_FW_VER
	string "pci-swdev-fwver"
	help
	  Switchdev Agent FirmWare Version

config BR2_PACKAGE_CPSS_AGENT_SRC_DEBUG_INFO
	bool "cpss-app-demo-dbg-info"
	help
	  Build with debug info

config BR2_PACKAGE_CPSS_AGENT_SRC_STATIC
	bool "cpss-fw-application-static"
	help
	  Build FW application static in addition to dynamic

endif
```

## package/cpss/cpss-agent/Config.in
```kconfig
config BR2_PACKAGE_CPSS_AGENT
	bool "cpss-aagent"
	select BR2_PACKAGE_LIBNL if !BR2_PACKAGE_CPSS_AGENT_SWDEV_PCI
	select BR2_PACKAGE_LIBARCHIVE
	help
	  CPSS appDemo application

if BR2_PACKAGE_CPSS_AGENT

config BR2_PACKAGE_CPSS_AGENT_SWDEV_PCI
	bool "pci-swdev-ipc"
	help
	  Use PCI as communication bus between SwDevAgent and Switchdev.

config BR2_PACKAGE_CPSS_AGENT_SWDEV_IPC_ADDR
	string "pci-swdev-ipc-addr"
	help
	  Switchdev Agent IPC physical address

config BR2_PACKAGE_CPSS_AGENT_SWDEV_IPC_SIZE
	string "pci-swdev-ipc-size"
	help
	  Switchdev Agent IPC size

config BR2_PACKAGE_CPSS_AGENT_SWDEV_TESTS
	bool "pci-swdev-tests"
	help
	  Build agent with swdev tests

config BR2_PACKAGE_CPSS_AGENT_SWDEV_FW_VER
	string "pci-swdev-fwver"
	help
	  Switchdev Agent FirmWare Version

config BR2_PACKAGE_CPSS_AGENT_DEBUG_INFO
	bool "cpss-app-demo-dbg-info"
	help
	  Build with debug info

config BR2_PACKAGE_CPSS_AGENT_STATIC
	bool "cpss-app-demo-static"
	help
	  Build appDemo static in addition to dynamic

endif
```

## package/cpss/cpss-drivers-kmod/Config.in
```kconfig
config BR2_PACKAGE_CPSS_DRIVERS_KMOD
	bool "cpss-drivers-kmod"
	help
	  CPSS Linux kernel modules
```

## package/date-fixup/Config.in
```kconfig
config BR2_PACKAGE_DATE_FIXUP
	bool "date-fixup"
	help
	  Date fixup init script.
```

## package/iniparser/Config.in.host
```kconfig
config BR2_PACKAGE_HOST_INIPARSER
	bool "host-iniparser"
	help
	  This modules offers parsing of ini files from the C level.

	  https://github.com/ndevilla/iniparser
```

## package/mstpd/Config.in
```kconfig
config BR2_PACKAGE_MSTPD
	bool "mstpd"
	depends on BR2_PACKAGE_BASH # init
	help
	  Multiple Spanning Tree Protocol Daemon

	  MSTPD is an open source user-space daemon licensed under GPLv2.

	  https://github.com/mstpd/mstpd

comment "mstpd requires bash"
	depends on !BR2_PACKAGE_BASH
```

## package/platform-drivers/Config.in
```kconfig
config BR2_PACKAGE_PLATFORM_DRIVERS
	bool "platform-drivers"
	help
	  Marvell's Switchdev platform drivers

if BR2_PACKAGE_PLATFORM_DRIVERS

config BR2_PACKAGE_PLAT_GPIO_I2C
	bool "gpio-i2c-driver"
	help
	  GPIO I2C driver.

endif
```

## package/prestera-driver/Config.in
```kconfig
config BR2_PACKAGE_PRESTERA_DRIVER
	bool "prestera-driver"
	help
	  Marvell's Prestera Switchdev kernel module

config BR2_PACKAGE_PRESTERA_DRIVER_IPC_TRAMPOLINE
	bool "prestera-driver-ipc-trampoline"
	help
	  Marvell's Prestera Switchdev kernel module
```

## package/prestera-log/Config.in
```kconfig
config BR2_PACKAGE_PRESTERA_LOG
        bool "prestera-log"
        select BR2_PACKAGE_DCRON
        select BR2_PACKAGE_LOGROTATE
        help
          Logging support for Prestera device.
```

## package/prestera-qa/Config.in
```kconfig
config BR2_PACKAGE_PRESTERA_QA
	bool "prestera qa required changes"
	help
	  Prestera SwitchDev fixups/files/changes needed by QA.
```

## package/prestera-ssh/Config.in
```kconfig
config BR2_PACKAGE_PRESTERA_SSH
	bool "Enable rootless SSH access"
	select BR2_PACKAGE_OPENSSH
	help
	  Enable rootless SSH access.
```

## package/prestera-system/Config.in
```kconfig
config BR2_PACKAGE_PRESTERA_SYSTEM
	bool "Prestera userspace init, setup, etc"
	depends on BR2_PACKAGE_HAS_UDEV
	help
	  Prestera user space configs, setup, etc.
```

## package/prestera-utils/Config.in
```kconfig
config BR2_PACKAGE_PRESTERA_UTILS
	bool "prestera utils"
	help
	  Various prestera switch utils
```

## package/rtrlib/Config.in
```kconfig
config BR2_PACKAGE_RTRLIB
	bool "rtrlib"
	depends on BR2_TOOLCHAIN_HAS_THREADS
	depends on BR2_TOOLCHAIN_HAS_SSP
	help
	  An open-source C implementation of the RPKI/Router Protocol client.

	  http://rtrlib.realmv6.org

comment "rtrlib requires toolchain w/ threads, SSP"
	  depends on !BR2_TOOLCHAIN_HAS_THREADS || \
		  !BR2_TOOLCHAIN_HAS_SSP
```
